// SPDX-License-Identifier: GPL-2.0+
/*
 * Copyright 2022 NXP
 * Copyright 2023-2026 Variscite Ltd.
 */

#include "imx93-var-common-u-boot.dtsi"

&lpi2c1 {
	bootph-all;
};

&pinctrl_lpi2c1 {
	bootph-all;
};
