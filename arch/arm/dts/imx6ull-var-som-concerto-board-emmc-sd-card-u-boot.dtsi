/*
 * Copyright (C) 2025 Variscite Ltd. - https://www.variscite.com
 *
 * This program is free software; you can redistribute it and/or modify
 * it under the terms of the GNU General Public License version 2 as
 * published by the Free Software Foundation.
 */

#include "imx6ul-imx6ull-var-common-u-boot.dtsi"

/ {
	model = "Variscite VAR-SOM-6UL with i.MX6ULL, eMMC & SD card support on Concerto-Board";
	compatible = "variscite,imx6ul-var-som", "fsl,imx6ull";
};
