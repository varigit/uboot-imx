/*
 * Copyright (C) 2025 Variscite Ltd. - https://www.variscite.com
 *
 * This program is free software; you can redistribute it and/or modify
 * it under the terms of the GNU General Public License version 2 as
 * published by the Free Software Foundation.
 */

/ {
        model = "Variscite VAR-SOM-6UL with i.MX6ULZ, NAND flash & SD card support on Symphony-Board";
        compatible = "variscite,imx6ul-var-som", "fsl,imx6ulz";
};
