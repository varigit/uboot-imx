// SPDX-License-Identifier: GPL-2.0+
/*
 * Copyright 2019 NXP
 * Copyright 2020-2026 Variscite Ltd.
 */

#include "imx8mp-var-common-u-boot.dtsi"

&uart1 {
	bootph-pre-ram;
};

&pinctrl_uart1 {
	bootph-pre-ram;
};
