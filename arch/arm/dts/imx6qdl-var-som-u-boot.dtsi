// SPDX-License-Identifier: GPL-2.0+
/*
 * Copyright (C) 2019 NXP
 * Copyright (C) 2024 Variscite Ltd.
 */

#include "imx6qdl-var-u-boot.dtsi"

&usdhc1 {
	bootph-pre-ram;
};

&pinctrl_usdhc1 {
	bootph-pre-ram;
};

&gpio1 {
	bootph-pre-ram;
};
