/*
 * Copyright (C) 2025 Variscite Ltd. - https://www.variscite.com
 *
 * This program is free software; you can redistribute it and/or modify
 * it under the terms of the GNU General Public License version 2 as
 * published by the Free Software Foundation.
 */

&display0 {
	bits-per-pixel = <24>;
};
