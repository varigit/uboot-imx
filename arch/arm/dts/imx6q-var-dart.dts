/*
 * Copyright (C) 2015-2024 Variscite Ltd.
 *
 * This program is free software; you can redistribute it and/or modify
 * it under the terms of the GNU General Public License version 2 as
 * published by the Free Software Foundation.
 */

/dts-v1/;

#include "imx6q.dtsi"
#include "imx6qdl-var-dart.dtsi"
#include "imx6qdl-var-dt6cb-misc.dtsi"

/ {
	model = "Variscite i.MX6 Quad/Dual DART-MX6";
	compatible = "variscite,imx6q-var-dart", "fsl,imx6q";
};
