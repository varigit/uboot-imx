## board/toradex/verdin-imx95/Kconfig
```kconfig
if TARGET_VERDIN_IMX95_19X19

config SYS_BOARD
	default "verdin-imx95"

config SYS_VENDOR
	default "toradex"

config SYS_CONFIG_NAME
	default "verdin-imx95"

endif
```

## board/variscite/common/Kconfig
```kconfig
config EXTCON_PTN5150
	bool "NXP PTN5150 CC LOGIC USB EXTCON support"
	default n
	help
	  Say Y here to enable support for USB peripheral and USB host
	  detection by NXP PTN5150 CC (Configuration Channel) logic chip.
```

## board/variscite/imx8m_var_dart/Kconfig
```kconfig
if TARGET_IMX8M_VAR_DART

config SYS_BOARD
	default "imx8m_var_dart"

config SYS_VENDOR
	default "variscite"

config SYS_CONFIG_NAME
	default "imx8m_var_dart"

endif
```

## board/variscite/imx8mm_var_dart/Kconfig
```kconfig
if TARGET_IMX8MM_VAR_DART

config SYS_BOARD
	default "imx8mm_var_dart"

config SYS_VENDOR
	default "variscite"

config SYS_CONFIG_NAME
	default "imx8mm_var_dart"

source "board/variscite/common/Kconfig"

endif
```

## board/variscite/imx8mn_var_som/Kconfig
```kconfig
if TARGET_IMX8MN_VAR_SOM

config SYS_BOARD
	default "imx8mn_var_som"

config SYS_VENDOR
	default "variscite"

config SYS_CONFIG_NAME
	default "imx8mn_var_som"

config IMX8MN_FORCE_NOM_SOC
	bool "Force to use nominal mode for SOC and ARM"
	default n

source "board/freescale/common/Kconfig"

endif
```

## board/variscite/imx8mp_var_dart/Kconfig
```kconfig
if TARGET_IMX8MP_VAR_DART

config SYS_BOARD
	default "imx8mp_var_dart"

config SYS_VENDOR
	default "variscite"

config SYS_CONFIG_NAME
	default "imx8mp_var_dart"

source "board/variscite/common/Kconfig"

endif
```

## board/variscite/imx8mq_var_dart/Kconfig
```kconfig
if TARGET_IMX8MQ_VAR_DART

config SYS_BOARD
	default "imx8mq_var_dart"

config SYS_VENDOR
	default "variscite"

config SYS_CONFIG_NAME
	default "imx8mq_var_dart"

source "board/freescale/common/Kconfig"

endif
```

## board/variscite/imx8qm_var_som/Kconfig
```kconfig
if TARGET_IMX8QM_VAR_SOM

config SYS_BOARD
	default "imx8qm_var_som"

config SYS_VENDOR
	default "variscite"

config SYS_CONFIG_NAME
	default "imx8qm_var_som"

endif
```

## board/variscite/imx8qm_var_spear/Kconfig
```kconfig
if TARGET_IMX8QM_VAR_SPEAR

config SYS_BOARD
	default "imx8qm_var_spear"

config SYS_VENDOR
	default "variscite"

config SYS_CONFIG_NAME
	default "imx8qm_var_spear"

endif
```

## board/variscite/imx8qxp_var_som/Kconfig
```kconfig
if TARGET_IMX8QXP_VAR_SOM

config SYS_BOARD
	default "imx8qxp_var_som"

config SYS_VENDOR
	default "variscite"

config SYS_CONFIG_NAME
	default "imx8qxp_var_som"

source "board/freescale/common/Kconfig"

endif
```

## board/variscite/imx95_var_dart/Kconfig
```kconfig
if TARGET_IMX95_VAR_DART

config SYS_BOARD
	default "imx95_var_dart"

config SYS_VENDOR
	default "variscite"

config SYS_CONFIG_NAME
	default "imx95_var_dart"

source "board/variscite/common/Kconfig"

endif
```

## board/variscite/mx6p_var_som/Kconfig
```kconfig
if TARGET_MX6P_VAR_SOM

config SYS_BOARD
	default "mx6p_var_som"

config SYS_VENDOR
	default "variscite"

config SYS_SOC
	default "mx6"

config SYS_CONFIG_NAME
	default "mx6p_var_som"

endif
```

## board/variscite/mx6ul_var_dart/Kconfig
```kconfig
if TARGET_MX6UL_VAR_DART

config SYS_BOARD
	default "mx6ul_var_dart"

config SYS_VENDOR
	default "variscite"

config SYS_CONFIG_NAME
	default "mx6ul_var_dart"

endif
```

## board/variscite/mx6var_som/Kconfig
```kconfig
if TARGET_MX6VAR_SOM

config SYS_BOARD
	default "mx6var_som"

config SYS_VENDOR
	default "variscite"

config SYS_CONFIG_NAME
	default "mx6var_som"

endif
```

## board/variscite/mx7dvar_som/Kconfig
```kconfig
if TARGET_MX7DVAR_SOM

config SYS_BOARD
	default "mx7dvar_som"

config SYS_VENDOR
	default "variscite"

config SYS_CONFIG_NAME
	default "mx7dvar_som"

endif
```

## board/voxelbotics/navqp/Kconfig
```kconfig
if TARGET_NAVQPLUS

config SYS_BOARD
	default "navqp"

config SYS_VENDOR
	default "voxelbotics"

config SYS_CONFIG_NAME
	default "navqp"

config IMX_CONFIG
	default "board/voxelbotics/navqp/imximage-8mp-lpddr4.cfg"

endif
```

## configs/imx8mm_var_dart_android_uuu_defconfig
```kconfig
CONFIG_ARM=y
CONFIG_ARCH_IMX8M=y
CONFIG_SYS_TEXT_BASE=0x40200000
CONFIG_SYS_MALLOC_F_LEN=0x2000
CONFIG_USB_TCPC=y
CONFIG_TARGET_IMX8MM_VAR_DART=y
CONFIG_SYS_EXTRA_OPTIONS="IMX_CONFIG=arch/arm/mach-imx/imx8m/imximage.cfg,SPL_TEXT_BASE=0x7E1000,ANDROID_SUPPORT"
CONFIG_FIT=y
CONFIG_SPL_LOAD_FIT=y
CONFIG_EFI_PARTITION=y
CONFIG_ARCH_MISC_INIT=y
CONFIG_SPL=y
CONFIG_SPL_BOARD_INIT=y
CONFIG_SPL_MMC_SUPPORT=y
CONFIG_SPL_SERIAL_SUPPORT=y
CONFIG_HUSH_PARSER=y
CONFIG_OF_LIBFDT=y
CONFIG_FS_FAT=y
CONFIG_CMD_EXT2=y
CONFIG_CMD_EXT4=y
CONFIG_CMD_EXT4_WRITE=y
CONFIG_CMD_FAT=y
CONFIG_DEFAULT_DEVICE_TREE="fsl-imx8mm-var-dart"
CONFIG_ENV_IS_IN_MMC=y
#CONFIG_CMD_SF=y
CONFIG_CMD_I2C=y
CONFIG_CMD_GPIO=y
CONFIG_CMD_CACHE=y
CONFIG_CMD_REGULATOR=y
CONFIG_OF_CONTROL=y

CONFIG_DM_GPIO=y
CONFIG_SYS_I2C_MXC=y
CONFIG_DM_MMC=y
CONFIG_DM_ETH=y
CONFIG_PINCTRL=y
CONFIG_PINCTRL_IMX8M=y
CONFIG_DM_REGULATOR=y
CONFIG_DM_REGULATOR_FIXED=y
CONFIG_DM_REGULATOR_GPIO=y
CONFIG_NXP_TMU=y
CONFIG_DM_THERMAL=y
CONFIG_USB=y
CONFIG_DM_USB=y
CONFIG_CI_UDC=y
CONFIG_USB_EHCI_HCD=y
CONFIG_LZ4=y
CONFIG_FLASH_MCUFIRMWARE_SUPPORT=y
CONFIG_USB_GADGET=y
CONFIG_USB_GADGET_MANUFACTURER="Variscite"
CONFIG_USB_GADGET_VENDOR_NUM=0x0525
CONFIG_USB_GADGET_PRODUCT_NUM=0xa4a5
CONFIG_SPL_USB_GADGET=y
CONFIG_FASTBOOT=y
CONFIG_USB_FUNCTION_FASTBOOT=y
CONFIG_CMD_FASTBOOT=y
CONFIG_ANDROID_BOOT_IMAGE=y
CONFIG_FASTBOOT_UUU_SUPPORT=n
CONFIG_FSL_FASTBOOT=y
CONFIG_FASTBOOT_BUF_ADDR=0x42800000
CONFIG_FASTBOOT_BUF_SIZE=0x19000000
CONFIG_FASTBOOT_FLASH=y
CONFIG_LIBAVB=y
CONFIG_APPEND_BOOTARGS=y
```

## configs/imx8mm_var_dart_defconfig
```kconfig
CONFIG_ARM=y
CONFIG_ARCH_IMX8M=y
CONFIG_TEXT_BASE=0x40200000
CONFIG_SYS_MALLOC_LEN=0x2000000
CONFIG_SPL_GPIO=y
CONFIG_SPL_LIBCOMMON_SUPPORT=y
CONFIG_SPL_LIBGENERIC_SUPPORT=y
CONFIG_NR_DRAM_BANKS=3
CONFIG_ENV_SIZE=0x4000
CONFIG_ENV_OFFSET=0x700000
CONFIG_SYS_I2C_MXC_I2C1=y
CONFIG_SYS_I2C_MXC_I2C2=y
CONFIG_SYS_I2C_MXC_I2C3=y
CONFIG_SYS_I2C_MXC_I2C4=y
CONFIG_DM_GPIO=y
CONFIG_DEFAULT_DEVICE_TREE="imx8mm-var-dart-customboard"
CONFIG_SPL_TEXT_BASE=0x7E1000
CONFIG_TARGET_IMX8MM_VAR_DART=y
CONFIG_EXTCON_PTN5150=y
CONFIG_SYS_PROMPT="u-boot=> "
CONFIG_SPL_MMC=y
CONFIG_SPL_SERIAL=y
CONFIG_SPL_DRIVERS_MISC=y
CONFIG_SPL_STACK=0x920000
CONFIG_SPL=y
CONFIG_IMX_BOOTAUX=y
CONFIG_SYS_LOAD_ADDR=0x40480000
CONFIG_SYS_MEMTEST_START=0x40000000
CONFIG_SYS_MEMTEST_END=0x80000000
CONFIG_LTO=y
CONFIG_SYS_MONITOR_LEN=524288
CONFIG_FIT=y
CONFIG_FIT_EXTERNAL_OFFSET=0x3000
CONFIG_FIT_SIGNATURE=y
CONFIG_SPL_LOAD_FIT=y
CONFIG_LEGACY_IMAGE_FORMAT=y
CONFIG_OF_SYSTEM_SETUP=y
CONFIG_DISTRO_DEFAULTS=y
CONFIG_BOOTDELAY=1
CONFIG_BOOTCOMMAND="run bsp_bootcmd"
CONFIG_DEFAULT_FDT_FILE="imx8mm-var-dart.dtb"
CONFIG_BOARD_EARLY_INIT_F=y
CONFIG_BOARD_LATE_INIT=y
CONFIG_SPL_HAS_BSS_LINKER_SECTION=y
CONFIG_SPL_BSS_START_ADDR=0x910000
CONFIG_SPL_BSS_MAX_SIZE=0x2000
CONFIG_SPL_BOARD_INIT=y
# CONFIG_SPL_SHARES_INIT_SP_ADDR is not set
CONFIG_SYS_SPL_MALLOC=y
CONFIG_HAS_CUSTOM_SPL_MALLOC_START=y
CONFIG_CUSTOM_SYS_SPL_MALLOC_ADDR=0x42200000
CONFIG_SYS_SPL_MALLOC_SIZE=0x80000
CONFIG_SYS_MMCSD_RAW_MODE_U_BOOT_USE_SECTOR=y
CONFIG_SYS_MMCSD_RAW_MODE_U_BOOT_SECTOR=0x300
CONFIG_SPL_I2C=y
CONFIG_SPL_POWER=y
CONFIG_SPL_USB_HOST=y
CONFIG_SPL_USB_GADGET=y
CONFIG_SPL_USB_SDP_SUPPORT=y
CONFIG_SPL_WATCHDOG=y
CONFIG_KASLR=y
CONFIG_SYS_MAXARGS=64
CONFIG_SYS_CBSIZE=2048
CONFIG_SYS_PBSIZE=2074
# CONFIG_BOOTM_NETBSD is not set
CONFIG_SYS_BOOTM_LEN=0x2000000
# CONFIG_CMD_EXPORTENV is not set
CONFIG_CMD_ERASEENV=y
CONFIG_CMD_NVEDIT_EFI=y
CONFIG_CRC32_VERIFY=y
CONFIG_CMD_MEMTEST=y
CONFIG_CMD_CLK=y
CONFIG_CMD_DFU=y
CONFIG_CMD_FUSE=y
CONFIG_CMD_GPIO=y
CONFIG_CMD_I2C=y
CONFIG_CMD_MMC=y
CONFIG_CMD_OPTEE_RPMB=y
CONFIG_CMD_POWEROFF=y
CONFIG_CMD_USB=y
CONFIG_CMD_USB_SDP=y
CONFIG_CMD_USB_MASS_STORAGE=y
CONFIG_BOOTP_PREFER_SERVERIP=y
CONFIG_CMD_SNTP=y
CONFIG_CMD_CACHE=y
CONFIG_CMD_EFIDEBUG=y
CONFIG_CMD_RTC=y
CONFIG_CMD_TIME=y
CONFIG_CMD_GETTIME=y
CONFIG_CMD_TIMER=y
CONFIG_CMD_REGULATOR=y
CONFIG_CMD_EXT4_WRITE=y
CONFIG_OF_CONTROL=y
CONFIG_ENV_OVERWRITE=y
CONFIG_ENV_IS_IN_MMC=y
CONFIG_SYS_RELOC_GD_ENV_ADDR=y
CONFIG_SYS_MMC_ENV_DEV=1
CONFIG_USE_ETHPRIME=y
CONFIG_ETHPRIME="FEC"
CONFIG_NET_RANDOM_ETHADDR=y
CONFIG_CLK_IMX8MM=y
CONFIG_IMX8M_DDRPHY_FW_OFFSET=73728
CONFIG_DFU_TFTP=y
CONFIG_DFU_MMC=y
CONFIG_DFU_RAM=y
CONFIG_USB_FUNCTION_FASTBOOT=y
CONFIG_UDP_FUNCTION_FASTBOOT=y
CONFIG_FASTBOOT_BUF_ADDR=0x42800000
CONFIG_FASTBOOT_BUF_SIZE=0x40000000
CONFIG_FASTBOOT_FLASH=y
CONFIG_GPIO_HOG=y
CONFIG_MXC_GPIO=y
CONFIG_DM_PCA953X=y
CONFIG_DM_I2C=y
CONFIG_SPL_SYS_I2C_LEGACY=y
CONFIG_SUPPORT_EMMC_RPMB=y
CONFIG_SUPPORT_EMMC_BOOT=y
CONFIG_MMC_IO_VOLTAGE=y
CONFIG_MMC_UHS_SUPPORT=y
CONFIG_MMC_HS400_ES_SUPPORT=y
CONFIG_MMC_HS400_SUPPORT=y
CONFIG_FSL_USDHC=y
CONFIG_PHYLIB=y
CONFIG_PHY_ADIN=y
CONFIG_PHY_ATHEROS=y
CONFIG_PHY_MXL8611X=y
CONFIG_DM_ETH_PHY=y
CONFIG_PHY_GIGE=y
CONFIG_FEC_MXC=y
CONFIG_MII=y
CONFIG_PINCTRL=y
CONFIG_PINCTRL_IMX8M=y
CONFIG_SPL_POWER_LEGACY=y
CONFIG_POWER_DOMAIN=y
CONFIG_IMX8M_POWER_DOMAIN=y
CONFIG_POWER_BD71837=y
CONFIG_DM_REGULATOR=y
CONFIG_DM_REGULATOR_FIXED=y
CONFIG_DM_REGULATOR_GPIO=y
CONFIG_SPL_POWER_I2C=y
CONFIG_DM_RNG=y
CONFIG_DM_RTC=y
CONFIG_RTC_EMULATION=y
CONFIG_DM_SERIAL=y
CONFIG_MXC_UART=y
CONFIG_SYSRESET=y
CONFIG_SYSRESET_PSCI=y
CONFIG_TEE=y
CONFIG_OPTEE=y
CONFIG_DM_THERMAL=y
CONFIG_IMX_TMU=y
CONFIG_USB=y
CONFIG_USB_EHCI_HCD=y
CONFIG_MXC_USB_OTG_HACTIVE=y
CONFIG_USB_MAX_CONTROLLER_COUNT=2
CONFIG_USB_HOST_ETHER=y
CONFIG_USB_GADGET=y
CONFIG_USB_GADGET_MANUFACTURER="Variscite"
CONFIG_USB_GADGET_VENDOR_NUM=0x1fc9
CONFIG_USB_GADGET_PRODUCT_NUM=0x0152
CONFIG_CI_UDC=y
CONFIG_SDP_LOADADDR=0x40400000
CONFIG_SPL_RSA=y
CONFIG_SHA384=y
CONFIG_LZO=y
CONFIG_BZIP2=y
CONFIG_OF_LIBFDT_OVERLAY=y
CONFIG_EFI_VAR_BUF_SIZE=139264
CONFIG_EFI_SET_TIME=y
CONFIG_EFI_RUNTIME_UPDATE_CAPSULE=y
CONFIG_EFI_CAPSULE_ON_DISK=y
CONFIG_EFI_IGNORE_OSINDICATIONS=y
CONFIG_EFI_CAPSULE_FIRMWARE_RAW=y
CONFIG_EFI_SECURE_BOOT=y
# CONFIG_OPTEE_LIB is not set
```
